## config/boards/shields/charybdis-shadow/Kconfig.shield
```kconfig
config SHIELD_CHARYBDIS_SHADOW_LEFT
	def_bool $(shields_list_contains,charybdis_shadow_left)

config SHIELD_CHARYBDIS_SHADOW_RIGHT
	def_bool $(shields_list_contains,charybdis_shadow_right)
```
